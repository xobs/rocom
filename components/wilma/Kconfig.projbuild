## components/wilma/Kconfig.projbuild
```kconfig
menu "Wilma Configuration"

    config WILMA_MAX_STA_CONN
        int "Maximum number of wifi clients in AP mode"
        default 4
        help
        Max number of wifi clients that can connect to AP mode.

    config WILMA_AP_SSID_PREFIX
        string "Access Point SSID Prefix"
        default "Farpatch"
        help
        SSID (network name) that the device will broadcast.

    config WILMA_AP_PASSWORD
        string "Access Point Password"
        default ""
        help
        Password used for the Access Point. Leave empty and set AUTH MODE to WIFI_AUTH_OPEN for no password.

    config WILMA_AP_CHANNEL
        int "Access Point WiFi Channel"
        default 1
        help
        Be careful you might not see the access point if you use a channel not allowed in your country.

    config WILMA_AP_IP
        string "Access Point IP Address"
        default "10.10.0.1"
        help
        This is used for the redirection to the captive portal. It is recommended to leave unchanged.

    config WILMA_AP_GATEWAY
        string "Access Point IP Gateway"
        default "10.10.0.1"
        help
        This is used for the redirection to the captive portal. It is recommended to leave unchanged.

    config WILMA_AP_NETMASK
        string "Access Point Netmask"
        default "255.0.0.0"
        help
        This is used for the redirection to the captive portal. It is recommended to leave unchanged.

    config WILMA_AP_MAX_CONNECTIONS
        int "Access Point Max Connections"
        default 4
        help
        Max is 4.

    config WILMA_AP_BEACON_INTERVAL
        int "Access Point Beacon Interval (ms)"
        default 100
        help
        100ms is the recommended default.

endmenu
```
